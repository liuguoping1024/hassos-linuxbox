## buildroot-external/configs/thirdreality_hubv3l_defconfig
```kconfig
BR2_aarch64=y
BR2_TOOLCHAIN_BUILDROOT_CXX=y
BR2_KERNEL_HEADERS_5_4=y
BR2_DL_DIR="/cache/dl"
BR2_CCACHE=y
BR2_CCACHE_DIR="/cache/cc"
BR2_ENABLE_LTO=y
BR2_GLOBAL_PATCH_DIR="$(BR2_EXTERNAL_HASSOS_PATH)/board/thirdreality/hubv3l/patches"
BR2_SSP_REGULAR=y
BR2_TARGET_GENERIC_HOSTNAME="HubV3L"
BR2_TARGET_GENERIC_ISSUE="Welcome to ThirdReality Home Assistant"
BR2_TARGET_GENERIC_ROOT_PASSWD="shushi16888"
BR2_INIT_SYSTEMD=y
# BR2_TARGET_GENERIC_REMOUNT_ROOTFS_RW is not set
BR2_ROOTFS_OVERLAY="$(BR2_EXTERNAL_HASSOS_PATH)/rootfs-overlay $(BR2_EXTERNAL_HASSOS_PATH)/board/thirdreality/rootfs-overlay $(BR2_EXTERNAL_HASSOS_PATH)/board/thirdreality/hubv3l/rootfs-overlay"
BR2_ROOTFS_POST_BUILD_SCRIPT="$(BR2_EXTERNAL_HASSOS_PATH)/scripts/post-build.sh"
BR2_ROOTFS_POST_IMAGE_SCRIPT="$(BR2_EXTERNAL_HASSOS_PATH)/scripts/post-image.sh"
BR2_ROOTFS_POST_SCRIPT_ARGS="$(BR2_EXTERNAL_HASSOS_PATH)/board/thirdreality/hubv3l $(BR2_EXTERNAL_HASSOS_PATH)/board/thirdreality/hubv3l/hassos-hook.sh"
BR2_SYSTEM_DEFAULT_PATH="/usr/local/bin:/usr/sbin:/usr/bin:/sbin:/bin"

# ---- Kernel: upstream v5.4.180 + SDK patches (46 patches) ----
BR2_LINUX_KERNEL=y
BR2_LINUX_KERNEL_CUSTOM_VERSION=y
BR2_LINUX_KERNEL_CUSTOM_VERSION_VALUE="5.4.180"
# Patches applied via BR2_GLOBAL_PATCH_DIR -> patches/linux/
BR2_LINUX_KERNEL_USE_CUSTOM_CONFIG=y
BR2_LINUX_KERNEL_CUSTOM_CONFIG_FILE="$(BR2_EXTERNAL_HASSOS_PATH)/board/thirdreality/kernel-linuxbox-hubv3l.config"
BR2_LINUX_KERNEL_IMAGEGZ=y
BR2_LINUX_KERNEL_DTS_SUPPORT=y
BR2_LINUX_KERNEL_INTREE_DTS_NAME="amlogic/axg_s420_1g"
BR2_LINUX_KERNEL_NEEDS_HOST_OPENSSL=y
BR2_LINUX_KERNEL_NEEDS_HOST_LIBELF=y

# ---- Packages ----
BR2_PACKAGE_BUSYBOX_CONFIG="$(BR2_EXTERNAL_HASSOS_PATH)/busybox.config"
BR2_PACKAGE_BUSYBOX_INDIVIDUAL_BINARIES=y
BR2_PACKAGE_JQ=y
BR2_PACKAGE_CIFS_UTILS=y
BR2_PACKAGE_E2FSPROGS_E2IMAGE=y
# BR2_PACKAGE_NFS_UTILS is not set
# BR2_PACKAGE_NFS_UTILS_RPC_NFSD is not set
BR2_PACKAGE_LINUX_FIRMWARE=y
BR2_PACKAGE_LINUX_FIRMWARE_COMPRESS=y
BR2_PACKAGE_LINUX_FIRMWARE_COMPRESS_ZSTD=n
BR2_PACKAGE_LINUX_FIRMWARE_USB_SERIAL_TI=y
BR2_PACKAGE_DBUS_BROKER=y
BR2_PACKAGE_LIBMNL=y
# BR2_PACKAGE_HUBV3_SUPERVISOR is not set
# BR2_PACKAGE_HUBV3_BRIDGE is not set
BR2_PACKAGE_LIBGPIOD_TOOLS=y
BR2_PACKAGE_NGHTTP2=y
BR2_PACKAGE_LIBIDN2=y
BR2_PACKAGE_CA_CERTIFICATES=y
BR2_PACKAGE_LIBCURL_CURL=y
BR2_PACKAGE_LIBDNET=y
BR2_PACKAGE_LIBCGROUP=y
BR2_PACKAGE_LIBCGROUP_TOOLS=y
BR2_PACKAGE_BLUEZ5_UTILS=y
BR2_PACKAGE_BLUEZ5_UTILS_CLIENT=y
BR2_PACKAGE_BLUEZ5_UTILS_TOOLS=y
BR2_PACKAGE_BLUEZ5_UTILS_DEPRECATED=y
BR2_PACKAGE_BLUEZ5_UTILS_PLUGINS_AUDIO=y
BR2_PACKAGE_BLUEZ5_UTILS_PLUGINS_HID=y
BR2_PACKAGE_BLUEZ5_UTILS_PLUGINS_HOG=y
BR2_PACKAGE_DHCP=y
BR2_PACKAGE_DHCP_CLIENT=y
BR2_PACKAGE_DROPBEAR=y
BR2_PACKAGE_DROPBEAR_CLIENT=y
BR2_PACKAGE_DROPBEAR_SMALL=y
# BR2_PACKAGE_IFUPDOWN_SCRIPTS is not set
BR2_PACKAGE_IPROUTE2=y
BR2_PACKAGE_LIBTIRPC=y
BR2_PACKAGE_IPTABLES_NFTABLES=y
BR2_PACKAGE_IPTABLES_NFTABLES_DEFAULT=y
BR2_PACKAGE_NETWORK_MANAGER=y
BR2_PACKAGE_NETWORK_MANAGER_CLI=y
# BR2_PACKAGE_RPCBIND is not set
BR2_PACKAGE_WIRELESS_REGDB=y
BR2_PACKAGE_IW=y
BR2_PACKAGE_WPA_SUPPLICANT=y
BR2_PACKAGE_WPA_SUPPLICANT_WEXT=y
BR2_PACKAGE_WPA_SUPPLICANT_AP_SUPPORT=y
BR2_PACKAGE_WPA_SUPPLICANT_WPA3=y
BR2_PACKAGE_WPA_SUPPLICANT_DBUS=y
BR2_PACKAGE_WPA_SUPPLICANT_DBUS_INTROSPECTION=y
BR2_PACKAGE_APPARMOR=y
BR2_PACKAGE_APPARMOR_PROFILES=y
# BR2_PACKAGE_TINI is not set
# BR2_PACKAGE_DOCKER_CLI is not set
# BR2_PACKAGE_DOCKER_ENGINE is not set
BR2_PACKAGE_PROCPS_NG=y
BR2_PACKAGE_SYSTEMD_JOURNAL_REMOTE=y
BR2_PACKAGE_SYSTEMD_COREDUMP=y
# BR2_PACKAGE_SYSTEMD_HWDB is not set
BR2_PACKAGE_SYSTEMD_LOGIND=y
# BR2_PACKAGE_SYSTEMD_NETWORKD is not set
BR2_PACKAGE_SYSTEMD_RANDOMSEED=y
BR2_PACKAGE_SYSTEMD_VCONSOLE_DEFAULT_KEYMAP=""
BR2_PACKAGE_UTIL_LINUX_BINARIES=y
BR2_PACKAGE_UTIL_LINUX_AGETTY=y
BR2_PACKAGE_UTIL_LINUX_LOGIN=y
BR2_PACKAGE_UTIL_LINUX_NOLOGIN=y
BR2_PACKAGE_UTIL_LINUX_PARTX=y
BR2_PACKAGE_UTIL_LINUX_ZRAMCTL=y
BR2_PACKAGE_UTIL_LINUX_FINDFS=y
BR2_PACKAGE_UTIL_LINUX_SWAPON=y
BR2_PACKAGE_UTIL_LINUX_RFKILL=y
BR2_PACKAGE_UTIL_LINUX_DMESG=y
# BR2_PACKAGE_SHADOW is not set
# BR2_PACKAGE_SHADOW_PASSWORDS is not set

# ---- Rootfs: erofs (same as hubv3a) ----
BR2_TARGET_ROOTFS_EROFS=y
BR2_TARGET_ROOTFS_EROFS_LZ4HC_LEVEL=12
# kernel 5.4 erofs does not support dedupe/fragments/ztailpacking
# BR2_TARGET_ROOTFS_EROFS_DEDUPE is not set
# BR2_TARGET_ROOTFS_EROFS_FRAGMENTS is not set
# BR2_TARGET_ROOTFS_EROFS_ZTAILPACKING is not set
# BR2_TARGET_ROOTFS_EROFS_PCLUSTERSIZE is not set
# boot.img uses a minimal initramfs (generated in hassos-hook.sh), not the full rootfs
# BR2_TARGET_ROOTFS_CPIO is not set
# BR2_TARGET_ROOTFS_TAR is not set

# ---- U-Boot: legacy SDK 2015.01 (via uboot-legacy package) ----
# BR2_TARGET_UBOOT is not set
BR2_PACKAGE_UBOOT_LEGACY=y
BR2_PACKAGE_UBOOT_LEGACY_BOARD_DEFCONFIG="axg_hubv3l_v1"
BR2_PACKAGE_UBOOT_LEGACY_SDK_PATH="/disk4T/liuguoping/sdk_A113X_202210"

# ---- Host tools ----
BR2_PACKAGE_HOST_DOSFSTOOLS=y
BR2_PACKAGE_HOST_E2FSPROGS=y
BR2_PACKAGE_HOST_MTOOLS=y
BR2_PACKAGE_HOST_UBOOT_TOOLS=y
BR2_PACKAGE_HOST_TEMPIO=y
BR2_PACKAGE_UDISKS2=y
BR2_PACKAGE_DOSFSTOOLS=y
BR2_PACKAGE_DOSFSTOOLS_FSCK_FAT=y
BR2_PACKAGE_E2FSPROGS=y
BR2_PACKAGE_RNG_TOOLS=y
BR2_PACKAGE_USB_MODESWITCH=y
BR2_PACKAGE_USB_MODESWITCH_DATA=y
BR2_PACKAGE_XZ=y
BR2_PACKAGE_HOST_KMOD_XZ=y
BR2_PACKAGE_ETHTOOL=y

# ---- No JETHOME_BURN for hubv3l ----
# BR2_PACKAGE_JETHOME_BURN is not set
# BR2_PACKAGE_AMLOGIC_BOOT_FIP_E is not set

# Python3 and BL706 flashing tool dependencies — DISABLED for debugging
# BR2_PACKAGE_PYTHON3 is not set
# BR2_PACKAGE_PYTHON3_XZ is not set
# BR2_PACKAGE_PYTHON_SETUPTOOLS is not set
# BR2_PACKAGE_PYTHON_PYSERIAL is not set
# BR2_PACKAGE_PYTHON_ECDSA is not set
# BR2_PACKAGE_PYTHON_PORTALOCKER is not set
# BR2_PACKAGE_PYTHON_PYCRYPTODOME is not set
# BR2_PACKAGE_PYTHON_BFLB_CRYPTO_PLUS is not set

# Zigbee2MQTT and dependencies — DISABLED for debugging
# BR2_PACKAGE_MOSQUITTO is not set
# BR2_PACKAGE_MOSQUITTO_BROKER is not set
# BR2_PACKAGE_NODEJS is not set
# BR2_PACKAGE_NODEJS_NPM is not set
# BR2_PACKAGE_ZIGBEE_HERDSMAN is not set
# BR2_PACKAGE_ZIGBEE2MQTT is not set
```

## buildroot-external/package/aml-bootloader-message/Config.in
```kconfig
config BR2_PACKAGE_AML_BOOTLOADER_MESSAGE
	bool "aml-bootloader-message"
	select BR2_PACKAGE_ZLIB
	help
	  Amlogic bootloader message tools.
	  Read and write the misc partition bootloader control block (BCB).
	  Used for A/B partition switching, recovery mode, and OTA markers.

	  Provides: urlmisc command-line tool and libbootloader_message.a

	  Source: sdk_A113X_202210/vendor/amlogic/aml_commonlib/bootloader_message
```

## buildroot-external/package/aml-bt-ct/Config.in
```kconfig
config BR2_PACKAGE_AML_BT_CT
	bool "aml-bt-ct"
	help
	  Amlogic W1 Bluetooth HCI attach tool and firmware.
	  Provides aml_bt_hciattach which initializes the W1 BT UART
	  interface and loads the BT firmware (fw_out.bin).

	  Required for Bluetooth functionality on HubV3L.

	  Source: sdk_A113X_202210/vendor/amlogic/aml_bt_ct
```

## buildroot-external/package/aml-bt/Config.in
```kconfig
config BR2_PACKAGE_AML_BT
	bool "aml-bt"
	depends on BR2_LINUX_KERNEL
	depends on BR2_PACKAGE_AML_WIFI
	help
	  Amlogic W1 Bluetooth SDIO driver (out-of-tree kernel module).
	  Produces sdio_bt.ko. Depends on aml-wifi for SDIO transport symbols.
```

## buildroot-external/package/aml-commonlib/Config.in
```kconfig
config BR2_PACKAGE_AML_COMMONLIB
	bool "aml-commonlib"
	help
	  Amlogic common library providing logging (aml_log) and
	  socket IPC (aml_socketipc) facilities used by other
	  Amlogic userspace tools (aml-util, etc.).

	  Source: sdk_A113X_202210/vendor/amlogic/aml_commonlib
```

## buildroot-external/package/aml-ubootenv/Config.in
```kconfig
config BR2_PACKAGE_AML_UBOOTENV
	bool "aml-ubootenv"
	select BR2_PACKAGE_ZLIB
	help
	  Amlogic U-Boot environment access tool (uenv).
	  Read and write U-Boot environment variables from Linux userspace.
	  Adapted for Amlogic's eMMC env storage format.

	  Useful for OTA upgrade markers, boot mode switching, and debugging.

	  Source: sdk_A113X_202210/vendor/amlogic/aml_commonlib/ubootenv
```

## buildroot-external/package/aml-util/Config.in
```kconfig
config BR2_PACKAGE_AML_UTIL
	bool "aml-util"
	depends on BR2_LINUX_KERNEL
	select BR2_PACKAGE_LIBUSB
	help
	  Amlogic system utility tools for HubV3L.
	  Includes wifi_power (WiFi power control), multi_wifi_load_driver
	  (WiFi/BT kernel module loader), and usb_monitor.

	  Source: sdk_A113X_202210/vendor/amlogic/aml_commonlib/utils
```

## buildroot-external/package/aml-wifi/Config.in
```kconfig
config BR2_PACKAGE_AML_WIFI
	bool "aml-wifi"
	depends on BR2_LINUX_KERNEL
	help
	  Amlogic W1 WiFi SDIO driver (out-of-tree kernel module).
	  Produces vlsicomm.ko and aml_sdio.ko.

	  Built using $(MAKE) -C $(LINUX_DIR) M= exactly like the SDK.
```

## buildroot-external/package/aml-wifibt-fw/Config.in
```kconfig
config BR2_PACKAGE_AML_WIFIBT_FW
	bool "aml-wifibt-fw"
	help
	  Amlogic W1 WiFi/BT firmware and RF configuration files.

	  WiFi: RF calibration data for various W1 chip revisions
	  (/etc/wifi/w1/aml_wifi_rf*.txt)

	  BT: UART firmware (w1_bt_fw_uart.bin), RF config, and
	  A2DP mode configuration (/etc/bluetooth/aml/)

	  Required for WiFi and Bluetooth on HubV3L.
```

## buildroot-external/package/hubv3-supervisor/Config.in
```kconfig
config BR2_PACKAGE_HUBV3_SUPERVISOR
	bool "hubv3-supervisor"
	depends on BR2_PACKAGE_BLUEZ5_UTILS
	depends on BR2_PACKAGE_HAS_UDEV # pkg_check_modules(LIBUDEV REQUIRED libudev)
	select BR2_PACKAGE_LIBGLIB2
	select BR2_PACKAGE_JSON_C
	select BR2_PACKAGE_AVAHI
	select BR2_PACKAGE_AVAHI_DAEMON
	select BR2_PACKAGE_LIBGPIOD
	select BR2_PACKAGE_OPENSSL
	select BR2_PACKAGE_LIBMICROHTTPD
	select BR2_PACKAGE_LIBCURL
	select BR2_PACKAGE_LIBYAML
	select BR2_PACKAGE_SQLITE
	select BR2_PACKAGE_CJSON
	# libmosquitto: hard requirement since supervisor 82834e07
	# (CMakeLists.txt aborts with FATAL_ERROR when mosquitto.h is absent).
	# Selected here rather than set per-board so a new board defconfig
	# cannot miss it.
	select BR2_PACKAGE_MOSQUITTO
	# libuuid, via pkg_check_modules(LIBUUID REQUIRED uuid)
	select BR2_PACKAGE_UTIL_LINUX
	select BR2_PACKAGE_UTIL_LINUX_LIBUUID
	help
	  LinuxBox Supervisor for ThirdReality Hub V3.
	  A C-based device management daemon providing hardware control
	  (LED, button, GPIO), network management, HTTP API, D-Bus service,
	  Zigbee/Thread device management, BLE provisioning, OTA upgrade,
	  mDNS broadcast, and Home Assistant integration.

	  https://github.com/liuguoping1024/LinuxBox_Supervisor

comment "hubv3-supervisor needs bluez5_utils"
	depends on !BR2_PACKAGE_BLUEZ5_UTILS

comment "hubv3-supervisor needs udev (systemd or eudev)"
	depends on !BR2_PACKAGE_HAS_UDEV
```

## buildroot-external/package/uboot-legacy/Config.in
```kconfig
config BR2_PACKAGE_UBOOT_LEGACY
	bool "uboot-legacy"
	help
	  Amlogic A113X (AXG) u-boot v2015.01 for the sdk54 board line
	  (hubv3a, hubv3l). Downloads upstream u-boot v2015.01, applies the
	  Amlogic SDK patches plus the per-board patch, compiles BL33, and
	  runs FIP packaging (bl2+bl30+bl301+bl31+bl33).
	  Produces u-boot.bin and variants in BINARIES_DIR.

if BR2_PACKAGE_UBOOT_LEGACY

config BR2_PACKAGE_UBOOT_LEGACY_BOARD
	string "u-boot board name"
	default "axg_hubv3l_v1"
	help
	  Amlogic board name: the prefix of <board>_config in u-boot and the
	  directory under board/amlogic/. Created by the board-level patch in
	  board/thirdreality/<dir>/patches/uboot-legacy/. Also selects which
	  sdk54/aml-fip/binary/board/amlogic/<board>/aml-user-key.sig is used
	  for secure-boot signing.

endif
```
