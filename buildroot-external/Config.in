## buildroot-external/Config.in
```kconfig
source "$BR2_EXTERNAL_HASSOS_PATH/package/bluetooth-rtl8723/Config.in"
source "$BR2_EXTERNAL_HASSOS_PATH/package/eq3_char_loop/Config.in"
source "$BR2_EXTERNAL_HASSOS_PATH/package/gasket/Config.in"
source "$BR2_EXTERNAL_HASSOS_PATH/package/generic_raw_uart/Config.in"
source "$BR2_EXTERNAL_HASSOS_PATH/package/hardkernel-boot/Config.in"
source "$BR2_EXTERNAL_HASSOS_PATH/package/hassio/Config.in"
source "$BR2_EXTERNAL_HASSOS_PATH/package/khadas-boot/Config.in"
source "$BR2_EXTERNAL_HASSOS_PATH/package/os-agent/Config.in"
source "$BR2_EXTERNAL_HASSOS_PATH/package/pi-bluetooth/Config.in"
source "$BR2_EXTERNAL_HASSOS_PATH/package/qemu-guest-agent/Config.in"
source "$BR2_EXTERNAL_HASSOS_PATH/package/lxd-guest-agent/Config.in"
source "$BR2_EXTERNAL_HASSOS_PATH/package/rockchip-blobs/Config.in"
source "$BR2_EXTERNAL_HASSOS_PATH/package/rpi-eeprom/Config.in"
source "$BR2_EXTERNAL_HASSOS_PATH/package/rpi-rf-mod/Config.in"
source "$BR2_EXTERNAL_HASSOS_PATH/package/rtl88x2bu/Config.in"
source "$BR2_EXTERNAL_HASSOS_PATH/package/tempio/Config.in.host"
source "$BR2_EXTERNAL_HASSOS_PATH/package/udisks2/Config.in"
source "$BR2_EXTERNAL_HASSOS_PATH/package/xe-guest-utilities/Config.in"
source "$BR2_EXTERNAL_HASSOS_PATH/package/amlogic-boot-fip-e/Config.in"
source "$BR2_EXTERNAL_HASSOS_PATH/package/uboot-legacy/Config.in"
source "$BR2_EXTERNAL_HASSOS_PATH/package/jethome-burn/Config.in"
source "$BR2_EXTERNAL_HASSOS_PATH/package/zigbee-herdsman/Config.in"
source "$BR2_EXTERNAL_HASSOS_PATH/package/zigbee2mqtt/Config.in"
source "$BR2_EXTERNAL_HASSOS_PATH/package/python-pyserial/Config.in"
source "$BR2_EXTERNAL_HASSOS_PATH/package/python-portalocker/Config.in"
source "$BR2_EXTERNAL_HASSOS_PATH/package/python-pycryptodome/Config.in"
source "$BR2_EXTERNAL_HASSOS_PATH/package/python-bflb-crypto-plus/Config.in"
source "$BR2_EXTERNAL_HASSOS_PATH/package/hubv3-supervisor/Config.in"
source "$BR2_EXTERNAL_HASSOS_PATH/package/hubv3-bridge/Config.in"
source "$BR2_EXTERNAL_HASSOS_PATH/package/aml-commonlib/Config.in"
source "$BR2_EXTERNAL_HASSOS_PATH/package/aml-util/Config.in"
source "$BR2_EXTERNAL_HASSOS_PATH/package/aml-bt-ct/Config.in"
source "$BR2_EXTERNAL_HASSOS_PATH/package/aml-ubootenv/Config.in"
source "$BR2_EXTERNAL_HASSOS_PATH/package/aml-bootloader-message/Config.in"
source "$BR2_EXTERNAL_HASSOS_PATH/package/aml-wifibt-fw/Config.in"
source "$BR2_EXTERNAL_HASSOS_PATH/package/aml-wifi/Config.in"
source "$BR2_EXTERNAL_HASSOS_PATH/package/aml-bt/Config.in"
```

## buildroot-external/configs/thirdreality_hubv3c_defconfig
```kconfig
BR2_aarch64=y
BR2_TOOLCHAIN_BUILDROOT_CXX=y
BR2_DL_DIR="/cache/dl"
BR2_CCACHE=y
BR2_CCACHE_DIR="/cache/cc"
BR2_ENABLE_LTO=y
BR2_GLOBAL_PATCH_DIR="$(BR2_EXTERNAL_HASSOS_PATH)/patches $(BR2_EXTERNAL_HASSOS_PATH)/board/thirdreality/patches"
BR2_SSP_REGULAR=y
BR2_TARGET_GENERIC_HOSTNAME="HubV3C"
BR2_TARGET_GENERIC_ISSUE="Welcome to ThirdReality HubV3C MB:v0.2 (buildroot)"
BR2_TARGET_GENERIC_ROOT_PASSWD="shushi16888"
BR2_INIT_SYSTEMD=y
# BR2_TARGET_GENERIC_REMOUNT_ROOTFS_RW is not set
BR2_ROOTFS_OVERLAY="$(BR2_EXTERNAL_HASSOS_PATH)/rootfs-overlay $(BR2_EXTERNAL_HASSOS_PATH)/board/thirdreality/rootfs-overlay $(BR2_EXTERNAL_HASSOS_PATH)/board/thirdreality/hubv3c/rootfs-overlay"
BR2_ROOTFS_POST_BUILD_SCRIPT="$(BR2_EXTERNAL_HASSOS_PATH)/scripts/post-build.sh"
BR2_ROOTFS_POST_IMAGE_SCRIPT="$(BR2_EXTERNAL_HASSOS_PATH)/scripts/post-image.sh"
BR2_ROOTFS_POST_SCRIPT_ARGS="$(BR2_EXTERNAL_HASSOS_PATH)/board/thirdreality/hubv3c $(BR2_EXTERNAL_HASSOS_PATH)/board/thirdreality/hubv3c/hassos-hook.sh"
BR2_SYSTEM_DEFAULT_PATH="/usr/local/bin:/usr/sbin:/usr/bin:/sbin:/bin"
BR2_LINUX_KERNEL=y
BR2_LINUX_KERNEL_CUSTOM_VERSION=y
BR2_LINUX_KERNEL_CUSTOM_VERSION_VALUE="6.6.120"
BR2_LINUX_KERNEL_USE_CUSTOM_CONFIG=y
BR2_LINUX_KERNEL_CUSTOM_CONFIG_FILE="$(BR2_EXTERNAL_HASSOS_PATH)/board/thirdreality/kernel-linuxbox-hubv3b.config"
BR2_LINUX_KERNEL_CONFIG_FRAGMENT_FILES="$(BR2_EXTERNAL_HASSOS_PATH)/kernel/v6.6.y/hassos.config $(BR2_EXTERNAL_HASSOS_PATH)/kernel/v6.6.y/device-support.config"
BR2_LINUX_KERNEL_LZ4=y
BR2_LINUX_KERNEL_DTS_SUPPORT=y
BR2_LINUX_KERNEL_INTREE_DTS_NAME="amlogic/meson-axg-thirdreality-hub-v3c"
BR2_LINUX_KERNEL_DTB_OVERLAY_SUPPORT=y
BR2_LINUX_KERNEL_NEEDS_HOST_OPENSSL=y
BR2_LINUX_KERNEL_NEEDS_HOST_LIBELF=y
BR2_PACKAGE_BUSYBOX_CONFIG="$(BR2_EXTERNAL_HASSOS_PATH)/busybox.config"
BR2_PACKAGE_BUSYBOX_INDIVIDUAL_BINARIES=y
BR2_PACKAGE_V4L2LOOPBACK=y
BR2_PACKAGE_JQ=y
BR2_PACKAGE_CIFS_UTILS=y
BR2_PACKAGE_E2FSPROGS_E2IMAGE=y
# BR2_PACKAGE_NFS_UTILS is not set
# BR2_PACKAGE_NFS_UTILS_RPC_NFSD is not set
# BR2_PACKAGE_RTL8822CS_NEW is not set
# BR2_PACKAGE_ARMBIAN_FIRMWARE is not set
# BR2_PACKAGE_ARMBIAN_FIRMWARE_AP6255 is not set
# BR2_PACKAGE_ARMBIAN_FIRMWARE_RTL8822CS is not set
BR2_PACKAGE_LINUX_FIRMWARE=y
BR2_PACKAGE_LINUX_FIRMWARE_COMPRESS=y
BR2_PACKAGE_LINUX_FIRMWARE_COMPRESS_ZSTD=n
# BR2_PACKAGE_LINUX_FIRMWARE_RTL_87XX_BT is not set
# BR2_PACKAGE_LINUX_FIRMWARE_RTL_88XX_BT is not set
# BR2_PACKAGE_LINUX_FIRMWARE_BRCM_BCM43XX is not set
# BR2_PACKAGE_LINUX_FIRMWARE_BRCM_BCM43XXX is not set
# BR2_PACKAGE_LINUX_FIRMWARE_RTL_87XX is not set
# BR2_PACKAGE_LINUX_FIRMWARE_RTL_RTW88 is not set
# BR2_PACKAGE_LINUX_FIRMWARE_RTL_RTW89 is not set
BR2_PACKAGE_LINUX_FIRMWARE_USB_SERIAL_TI=y
BR2_PACKAGE_DBUS_BROKER=y
BR2_PACKAGE_GPTFDISK=y
BR2_PACKAGE_GPTFDISK_SGDISK=y
BR2_PACKAGE_LIBMNL=y
# Supervisor (auto-selects its library dependencies)
BR2_PACKAGE_HUBV3_SUPERVISOR=y
BR2_PACKAGE_LIBGPIOD_TOOLS=y
BR2_PACKAGE_NGHTTP2=y
BR2_PACKAGE_LIBIDN2=y
# BR2_PACKAGE_LVM2_STANDARD_INSTALL is not set
#BR2_PACKAGE_RTL8821CU is not set
BR2_PACKAGE_CA_CERTIFICATES=y
BR2_PACKAGE_LIBCURL_CURL=y
BR2_PACKAGE_LIBDNET=y
BR2_PACKAGE_LIBCGROUP=y
BR2_PACKAGE_LIBCGROUP_TOOLS=y
BR2_PACKAGE_BLUEZ5_UTILS=y
BR2_PACKAGE_BLUEZ5_UTILS_CLIENT=y
BR2_PACKAGE_BLUEZ5_UTILS_TOOLS=y
BR2_PACKAGE_BLUEZ5_UTILS_DEPRECATED=y
BR2_PACKAGE_BLUEZ5_UTILS_PLUGINS_AUDIO=y
BR2_PACKAGE_BLUEZ5_UTILS_PLUGINS_HID=y
BR2_PACKAGE_DHCP=y
BR2_PACKAGE_DHCP_CLIENT=y
BR2_PACKAGE_DROPBEAR=y
BR2_PACKAGE_DROPBEAR_CLIENT=y
BR2_PACKAGE_DROPBEAR_SMALL=y
# BR2_PACKAGE_IFUPDOWN_SCRIPTS is not set
BR2_PACKAGE_IPROUTE2=y
BR2_PACKAGE_LIBTIRPC=y
BR2_PACKAGE_IPTABLES_NFTABLES=y
BR2_PACKAGE_IPTABLES_NFTABLES_DEFAULT=y
BR2_PACKAGE_NETWORK_MANAGER=y
BR2_PACKAGE_NETWORK_MANAGER_CLI=y
# BR2_PACKAGE_RPCBIND is not set
BR2_PACKAGE_WIRELESS_REGDB=y
BR2_PACKAGE_IW=y
BR2_PACKAGE_WPA_SUPPLICANT=y
BR2_PACKAGE_WPA_SUPPLICANT_WEXT=y
BR2_PACKAGE_WPA_SUPPLICANT_AP_SUPPORT=y
BR2_PACKAGE_WPA_SUPPLICANT_WPA3=y
BR2_PACKAGE_WPA_SUPPLICANT_DBUS=y
BR2_PACKAGE_WPA_SUPPLICANT_DBUS_INTROSPECTION=y
BR2_PACKAGE_APPARMOR=y
BR2_PACKAGE_APPARMOR_PROFILES=y
# BR2_PACKAGE_TINI is not set
# BR2_PACKAGE_DOCKER_CLI is not set
# BR2_PACKAGE_DOCKER_ENGINE is not set
BR2_PACKAGE_PROCPS_NG=y
BR2_PACKAGE_RAUC=y
BR2_PACKAGE_RAUC_DBUS=y
BR2_PACKAGE_RAUC_NETWORK=y
BR2_PACKAGE_SYSTEMD_JOURNAL_REMOTE=y
BR2_PACKAGE_SYSTEMD_COREDUMP=y
# BR2_PACKAGE_SYSTEMD_HWDB is not set
BR2_PACKAGE_SYSTEMD_LOGIND=y
# BR2_PACKAGE_SYSTEMD_NETWORKD is not set
BR2_PACKAGE_SYSTEMD_RANDOMSEED=y
BR2_PACKAGE_SYSTEMD_VCONSOLE_DEFAULT_KEYMAP=""
BR2_PACKAGE_UTIL_LINUX_BINARIES=y
BR2_PACKAGE_UTIL_LINUX_LOGIN=y
BR2_PACKAGE_UTIL_LINUX_NOLOGIN=y
BR2_PACKAGE_UTIL_LINUX_PARTX=y
BR2_PACKAGE_UTIL_LINUX_ZRAMCTL=y
BR2_PACKAGE_UTIL_LINUX_FINDFS=y
BR2_PACKAGE_UTIL_LINUX_SWAPON=y
BR2_PACKAGE_UTIL_LINUX_RFKILL=y
BR2_PACKAGE_UTIL_LINUX_DMESG=y
# BR2_PACKAGE_SHADOW is not set
# BR2_PACKAGE_SHADOW_PASSWORDS is not set
BR2_TARGET_ROOTFS_EROFS=y
BR2_TARGET_ROOTFS_EROFS_LZ4HC_LEVEL=12
BR2_TARGET_ROOTFS_EROFS_DEDUPE=y
BR2_TARGET_ROOTFS_EROFS_FRAGMENTS=y
BR2_TARGET_ROOTFS_EROFS_ZTAILPACKING=y
BR2_TARGET_ROOTFS_EROFS_PCLUSTERSIZE=262144
# BR2_TARGET_ROOTFS_TAR is not set
BR2_TARGET_UBOOT=y
BR2_TARGET_UBOOT_BUILD_SYSTEM_KCONFIG=y
BR2_TARGET_UBOOT_CUSTOM_VERSION=y
BR2_TARGET_UBOOT_CUSTOM_VERSION_VALUE="2024.01"
BR2_TARGET_UBOOT_BOARD_DEFCONFIG="hub_v3"
BR2_TARGET_UBOOT_CONFIG_FRAGMENT_FILES="$(BR2_EXTERNAL_HASSOS_PATH)/bootloader/uboot.config $(BR2_EXTERNAL_HASSOS_PATH)/board/thirdreality/hubv3c/uboot.config"
BR2_PACKAGE_HOST_DOSFSTOOLS=y
BR2_PACKAGE_HOST_E2FSPROGS=y
BR2_PACKAGE_HOST_GENIMAGE=y
BR2_PACKAGE_HOST_GPTFDISK=y
BR2_PACKAGE_HOST_MTOOLS=y
BR2_PACKAGE_HOST_RAUC=y
BR2_PACKAGE_HOST_UBOOT_TOOLS=y
BR2_PACKAGE_HOST_UBOOT_TOOLS_BOOT_SCRIPT=y
BR2_PACKAGE_HOST_UBOOT_TOOLS_BOOT_SCRIPT_SOURCE="$(BR2_EXTERNAL_HASSOS_PATH)/board/thirdreality/uboot-boot.ush"
BR2_PACKAGE_AMLOGIC_BOOT_FIP_E=y
BR2_PACKAGE_AMLOGIC_BOOT_FIP_E_BOARD="jethub-j100"
# BR2_PACKAGE_HASSIO is not set
# BR2_PACKAGE_HASSIO_ARCH="aarch64"
# BR2_PACKAGE_HASSIO_MACHINE="jethub-d1"
# BR2_PACKAGE_OS_AGENT is not set
# BR2_PACKAGE_OS_AGENT_BOARD="JetHub-D1"
# BR2_PACKAGE_RTL88X2BU is not set
BR2_PACKAGE_HOST_TEMPIO=y
BR2_PACKAGE_UDISKS2=y

BR2_PACKAGE_DOSFSTOOLS=y
BR2_PACKAGE_DOSFSTOOLS_FSCK_FAT=y
BR2_PACKAGE_E2FSPROGS=y
BR2_PACKAGE_SQUASHFS=y
BR2_PACKAGE_RNG_TOOLS=y
BR2_PACKAGE_BLUEZ5_UTILS_PLUGINS_HOG=y
BR2_PACKAGE_USB_MODESWITCH=y
BR2_PACKAGE_USB_MODESWITCH_DATA=y

BR2_PACKAGE_XZ=y
BR2_PACKAGE_HOST_KMOD_XZ=y

BR2_PACKAGE_JETHOME_BURN=y
BR2_PACKAGE_JETHOME_BURN_BOARD="jethubj100"
BR2_PACKAGE_ETHTOOL=y

# Python3 and BL706 flashing tool dependencies
BR2_PACKAGE_PYTHON3=y
BR2_PACKAGE_PYTHON3_XZ=y
BR2_PACKAGE_PYTHON_SETUPTOOLS=y
BR2_PACKAGE_PYTHON_PYSERIAL=y
BR2_PACKAGE_PYTHON_ECDSA=y
BR2_PACKAGE_PYTHON_PORTALOCKER=y
BR2_PACKAGE_PYTHON_PYCRYPTODOME=y
BR2_PACKAGE_PYTHON_BFLB_CRYPTO_PLUS=y

# Zigbee2MQTT and dependencies disabled for HubV3C (earliest/experimental
# revision, python3 tooling only for now)
# BR2_PACKAGE_MOSQUITTO is not set
# BR2_PACKAGE_MOSQUITTO_BROKER is not set
# BR2_PACKAGE_NODEJS is not set
# BR2_PACKAGE_NODEJS_NPM is not set
# BR2_PACKAGE_ZIGBEE_HERDSMAN is not set
# BR2_PACKAGE_ZIGBEE2MQTT is not set
```
